## config/boards/shields/Kconfig.defconfig
```kconfig
if SHIELD_CORNE_CUSTOM_LEFT || SHIELD_CORNE_CUSTOM_RIGHT

config ZMK_KEYBOARD_NAME
    default "Corne Custom"

config ZMK_SPLIT
    default y

endif
```

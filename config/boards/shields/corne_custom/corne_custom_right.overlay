// boards/shields/corne_custom_right.overlay
#include "corne_custom.dtsi"

&default_transform {
    col-offset = <6>;  
};

&kscan0 {
    status = "okay";
    row-gpios = <&gpio1 13 (GPIO_ACTIVE_HIGH | GPIO_PULL_DOWN)>,
                <&gpio1 11 (GPIO_ACTIVE_HIGH | GPIO_PULL_DOWN)>,
                <&gpio0 10  (GPIO_ACTIVE_HIGH | GPIO_PULL_DOWN)>,
                <&gpio0 9  (GPIO_ACTIVE_HIGH | GPIO_PULL_DOWN)>;

    col-gpios = <&gpio0 2 GPIO_ACTIVE_HIGH>,
                <&gpio0 29 GPIO_ACTIVE_HIGH>,
                <&gpio0 31 GPIO_ACTIVE_HIGH>,
                <&gpio0 22 GPIO_ACTIVE_HIGH>,
                <&gpio0 20 GPIO_ACTIVE_HIGH>,
                <&gpio0 11 GPIO_ACTIVE_HIGH>;
};




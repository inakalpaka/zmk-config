#include "corne_custom.dtsi"

/* Forzamos el mapeo de pines */
&kscan0 {
    status = "okay";
    row-gpios = <&gpio0 10 (GPIO_ACTIVE_HIGH | GPIO_PULL_DOWN)>,
                <&gpio0 11 (GPIO_ACTIVE_HIGH | GPIO_PULL_DOWN)>,
                <&gpio1 4 (GPIO_ACTIVE_HIGH | GPIO_PULL_DOWN)>,
                <&gpio1 6  (GPIO_ACTIVE_HIGH | GPIO_PULL_DOWN)>;

    col-gpios = <&gpio0 9  GPIO_ACTIVE_HIGH>,
                <&gpio0 29 GPIO_ACTIVE_HIGH>,
                <&gpio0 2  GPIO_ACTIVE_HIGH>,
                <&gpio0 17 GPIO_ACTIVE_HIGH>,
                <&gpio0 20 GPIO_ACTIVE_HIGH>,
                <&gpio0 22  GPIO_ACTIVE_HIGH>;
};

/ {
    /* Definimos el layout aquí mismo para que el compilador lo vea sí o sí */
    left_layout: left_layout {
        compatible = "zmk,physical-layout";
        display-name = "Default Layout";
        transform = <&default_transform>;
        kscan = <&kscan0>;
    };

    chosen {
        zmk,kscan = &kscan0;
        zmk,matrix_transform = &default_transform;
        /* Apuntamos al layout que acabamos de definir arriba */
        zmk,physical-layout = &left_layout;
    };
};

// boards/shields/corne_right.overlay
#include "corne.dtsi"

&default_transform {
    col-offset = <6>;  
};

&kscan0 {
    row-gpios = <&gpio1 10 (GPIO_ACTIVE_HIGH | GPIO_PULL_DOWN)>,
                <&gpio1 11 (GPIO_ACTIVE_HIGH | GPIO_PULL_DOWN)>,
                <&gpio0 4  (GPIO_ACTIVE_HIGH | GPIO_PULL_DOWN)>,
                <&gpio1 9  (GPIO_ACTIVE_HIGH | GPIO_PULL_DOWN)>;

    col-gpios = <&gpio1 29 GPIO_ACTIVE_HIGH>,
                <&gpio1 2  GPIO_ACTIVE_HIGH>,
                <&gpio1 17 GPIO_ACTIVE_HIGH>,
                <&gpio1 20 GPIO_ACTIVE_HIGH>,
                <&gpio1 22 GPIO_ACTIVE_HIGH>,
                <&gpio0 6  GPIO_ACTIVE_HIGH>;
};
